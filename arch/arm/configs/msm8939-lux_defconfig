## arch/arm/configs/msm8939-minilux_defconfig
```kconfig
CONFIG_AEABI=y
CONFIG_ANDROID_BINDER_IPC=y
CONFIG_ANDROID=y
CONFIG_APDS9930=y
CONFIG_ARCH_MSM8916=y
CONFIG_ARCH_MSM=y
CONFIG_ARM_DECOMPRESSOR_LIMIT=0x3200000
CONFIG_ASHMEM=y
CONFIG_AUDIT=y
CONFIG_AUTO_ZRELADDR=y
CONFIG_BACKLIGHT_CLASS_DEVICE=y
CONFIG_BACKLIGHT_LCD_SUPPORT=y
CONFIG_BACKLIGHT_LM3697=y
CONFIG_BACKLIGHT_LP855X=y
CONFIG_BALANCE_ANON_FILE_RECLAIM=y
CONFIG_BATTERY_BCL=y
CONFIG_BATTERY_MAX17042=y
CONFIG_BCM2079X=y
CONFIG_BLK_DEV_DM=y
CONFIG_BLK_DEV_INITRD=y
CONFIG_BLK_DEV_LOOP=y
CONFIG_BLK_DEV_RAM=y
CONFIG_BLK_DEV_SD=y
CONFIG_BOOTINFO=y
CONFIG_BOOTPARAM_SOFTLOCKUP_PANIC=y
CONFIG_BRIDGE_EBT_BROUTE=y
CONFIG_BRIDGE_NF_EBTABLES=y
CONFIG_BRIDGE=y
CONFIG_BUS_TOPOLOGY_ADHOC=y
CONFIG_CC_OPTIMIZE_FOR_SIZE=y
CONFIG_CC_STACKPROTECTOR_REGULAR=y
CONFIG_CGROUP_CPUACCT=y
CONFIG_CGROUP_DEBUG=y
CONFIG_CGROUP_FREEZER=y
CONFIG_CGROUP_MEM_RES_CTLR_SWAP=y
CONFIG_CGROUP_MEM_RES_CTLR=y
CONFIG_CGROUP_SCHED=y
CONFIG_CGROUPS=y
CONFIG_CLS_U32_MARK=y
CONFIG_CMA_SIZE_MBYTES=8
CONFIG_CMA=y
CONFIG_CORESIGHT=n
CONFIG_CP_ACCESS=y
CONFIG_CPU_FREQ_GOV_INTERACTIVE=y
CONFIG_CPU_FREQ_GOV_ONDEMAND=y
CONFIG_CPU_FREQ_GOV_POWERSAVE=y
CONFIG_CPU_FREQ_GOV_USERSPACE=y
CONFIG_CPU_HAS_L2_PMU=y
CONFIG_CPU_IDLE_MULTIPLE_DRIVERS=y
CONFIG_CPU_IDLE=y
CONFIG_CRYPTO_AES_ARM=y
CONFIG_CRYPTO_AES=y
CONFIG_CRYPTO_ANSI_CPRNG=y
CONFIG_CRYPTO_ARC4=y
CONFIG_CRYPTO_CTR=y
CONFIG_CRYPTO_DEV_QCEDEV=y
CONFIG_CRYPTO_DEV_QCE=y
CONFIG_CRYPTO_DEV_QCRYPTO=y
CONFIG_CRYPTO_MD4=y
CONFIG_CRYPTO_NULL=y
CONFIG_CRYPTO_RNG=y
CONFIG_CRYPTO_SHA1_ARM=y
CONFIG_CRYPTO_SHA256=y
CONFIG_CRYPTO_TWOFISH=y
CONFIG_CRYPTO_XCBC=y
CONFIG_CRYPTO_XTS=y
CONFIG_CRYPTO=y
CONFIG_DEBUG_INFO=y
CONFIG_DEBUG_MEMORY_INIT=y
CONFIG_DEBUG_MUTEXES=y
# CONFIG_DEBUG_PAGEALLOC is not set
CONFIG_DIAG_CHAR=y
CONFIG_DIAG_EXTENSION_SLATE=y
CONFIG_DIAG_OVER_TTY=y
CONFIG_DMADEVICES=y
CONFIG_DM_CRYPT=y
CONFIG_DM_REQ_CRYPT=y
CONFIG_DM_VERITY=n
CONFIG_DUMMY=y
CONFIG_DYNAMIC_DEBUG=y
CONFIG_EARLY_PRINTK=y
CONFIG_EMBEDDED=y
CONFIG_ESD_FS=y
CONFIG_EXFAT_FS=y
CONFIG_EXT4_FS_SECURITY=y
CONFIG_EXT4_FS_XATTR=y
CONFIG_EXT4_FS=y
CONFIG_EXT4_USE_FOR_EXT23=y
CONFIG_F2FS_FS_SECURITY=y
CONFIG_F2FS_FS_XATTR=y
CONFIG_F2FS_FS=y
CONFIG_FAIL_PAGE_ALLOC=y
CONFIG_FAN5404X_CHARGER=y
CONFIG_FB_MSM_MDSS_TIMEOUT_DUMP=y
CONFIG_FB_MSM_MDSS_WRITEBACK=y
CONFIG_FB_MSM_MDSS=y
CONFIG_FB_MSM=y
CONFIG_FB_VIRTUAL=y
CONFIG_FB=y
CONFIG_FORCE_INSTRUCTION_ALIGNMENT=y
CONFIG_FREE_PAGES_RDONLY=y
CONFIG_FUSE_FS=y
CONFIG_GPIO_ARIZONA=y
CONFIG_GPIO_QPNP_PIN=y
CONFIG_GPIO_SYSFS=y
CONFIG_HAPTIC_DRV2605=y
CONFIG_HAS_DMA=y
CONFIG_HAVE_ARCH_SECCOMP_FILTER=y
CONFIG_HID_MULTITOUCH=y
CONFIG_HIGHMEM=y
CONFIG_HIGH_RES_TIMERS=y
CONFIG_HOB_SHARED_RAM=y
CONFIG_HW_RANDOM_MSM=y
CONFIG_HW_RANDOM=y
CONFIG_I2C_CHARDEV=y
CONFIG_I2C_MSM_V2=y
CONFIG_I2C=y
CONFIG_IKCONFIG_PROC=y
CONFIG_IKCONFIG=y
CONFIG_INET_AH=y
CONFIG_INET_IPCOMP=y
CONFIG_INET_XFRM_MODE_BEET=y
CONFIG_INET_XFRM_MODE_TRANSPORT=y
CONFIG_INET_XFRM_MODE_TUNNEL=y
CONFIG_INET_XFRM_TUNNEL=y
CONFIG_INET=y
CONFIG_INPUT_EVDEV=y
CONFIG_INPUT_GPIO=y
CONFIG_INPUT_JOYSTICK=y
CONFIG_INPUT_KEYCHORD=y
CONFIG_INPUT_MISC=y
CONFIG_INPUT_MOUSEDEV=n
CONFIG_INPUT_MOUSE=n
CONFIG_INPUT_TOUCHSCREEN=y
CONFIG_INPUT_UINPUT=y
CONFIG_ION_MSM=y
CONFIG_ION=y
CONFIG_IPC_LOGGING=y
CONFIG_IPC_ROUTER_SECURITY=y
CONFIG_IPC_ROUTER=y
CONFIG_IP_MULTIPLE_TABLES=y
CONFIG_IP_PNP_DHCP=y
CONFIG_IP_PNP=y
CONFIG_IP_ROUTE_VERBOSE=y
CONFIG_IPV6=y
CONFIG_ISDBT_NMI=y
CONFIG_KERNEL_XZ=y
CONFIG_KEYBOARD_GPIO=y
CONFIG_KEYS=y
CONFIG_KGSL_PER_PROCESS_PAGE_TABLE=y
CONFIG_KPROBES=y
CONFIG_LCD_CLASS_DEVICE=y
CONFIG_LEDS_BD65B60=y
CONFIG_LEDS_GPIO=y
CONFIG_LEDS_ISL98611=y
CONFIG_LEDS_MSM_GPIO_FLASH=y
CONFIG_LEDS_QPNP=y
CONFIG_LEDS_TRIGGERS=y
CONFIG_LOCKUP_DETECTOR=y
CONFIG_LSM_MMAP_MIN_ADDR=4096
CONFIG_LZ4_COMPRESS=y
CONFIG_LZ4_DECOMPRESS=y
CONFIG_MAGIC_SYSRQ=y
CONFIG_MD=y
CONFIG_MEM_SHARE_QMI_SERVICE=y
CONFIG_MFD_ARIZONA_SPI=y
CONFIG_MFD_ARIZONA=y
CONFIG_MFD_CORE=y
CONFIG_MFD_FLORIDA=y
CONFIG_MFD_TI_LMU=y
CONFIG_MMC_BLOCK_MINORS=32
CONFIG_MMC_CLKGATE=y
CONFIG_MMC_EMBEDDED_SDIO=y
CONFIG_MMC_MSM_RAW=y
CONFIG_MMC_PARANOID_SD_INIT=y
CONFIG_MMC_PERF_PROFILING=y
CONFIG_MMC_SDHCI_MSM=y
CONFIG_MMC_SDHCI_PLTFM=y
CONFIG_MMC_SDHCI=y
CONFIG_MMC_UNSAFE_RESUME=y
CONFIG_MMC=y
CONFIG_MMI_DEVICE_DTBS=y
CONFIG_MMI_FACTORY=y
CONFIG_MMI_LUX_DTB=y
CONFIG_MMI_RAM_INFO=y
CONFIG_MMI_SOC_INFO=y
CONFIG_MMI_UNIT_INFO=y
CONFIG_MMU500_ACTIVE_PREFETCH_BUG_WITH_SECTION_MAPPING=y
CONFIG_MOT_UTAG=y
CONFIG_MSM_ADSP_LOADER=y
CONFIG_MSM_AVTIMER=y
CONFIG_MSM_BAM_DMUX=y
CONFIG_MSM_BOOT_STATS=y
CONFIG_MSM_BUSPM_DEV=y
CONFIG_MSM_BUS_SCALING=y
CONFIG_MSM_CCI=y
CONFIG_MSM_COMMON_LOG=y
CONFIG_MSM_CORE_CTL_HELPER=y
CONFIG_MSM_CPP=y
CONFIG_MSM_CSI30_HEADER=y
CONFIG_MSM_CSID=y
CONFIG_MSM_CSIPHY=y
CONFIG_MSM_DIRECT_SCLK_ACCESS=y
CONFIG_MSM_DLOAD_MODE=y
CONFIG_MSM_ENABLE_WDOG_DEBUG_CONTROL=y
CONFIG_MSM_FORCE_WDOG_BITE_ON_PANIC=y
CONFIG_MSM_IOMMU_V1=y
CONFIG_MSM_IPC_ROUTER_SMD_XPRT=y
CONFIG_MSM_ISPIF=y
CONFIG_MSM_KGSL=y
CONFIG_MSM_L2_SPM=y
CONFIG_MSM_MDSS_PLL=y
CONFIG_MSM_MEMORY_DUMP_V2=y
CONFIG_MSM_PERFORMANCE=y
CONFIG_MSM_PIL_MSS_QDSP6V5=y
CONFIG_MSM_PIL_SSR_GENERIC=y
CONFIG_MSM_PIL=y
CONFIG_MSM_QMI_INTERFACE=y
CONFIG_MSM_QPNP_INT=y
CONFIG_MSM_RMNET_BAM=y
CONFIG_MSM_RTB_SEPARATE_CPUS=y
CONFIG_MSM_RTB=y
CONFIG_MSM_SCM=y
CONFIG_MSM_SMCMOD=y
CONFIG_MSM_SMD_PKT=y
CONFIG_MSM_SMD=y
CONFIG_MSM_SMEM_LOGGING=y
CONFIG_MSM_SMEM=y
CONFIG_MSM_SMP2P_TEST=y
CONFIG_MSM_SMP2P=y
CONFIG_MSM_SPM=y
CONFIG_MSM_SUBSYSTEM_RESTART=y
CONFIG_MSM_SYSMON_COMM=y
CONFIG_MSM_TZ_LOG_WDOG_DUMP=y
CONFIG_MSM_TZ_LOG=y
CONFIG_MSM_VIDC_V4L2=y
CONFIG_MSM_WATCHDOG_CTX_PRINT=y
CONFIG_MSM_WATCHDOG_V2=y
CONFIG_MSM_XPU_ERR_FATAL=y
CONFIG_NAMESPACES=y
CONFIG_NEON=y
CONFIG_NET_SCHED=y
CONFIG_NET_SCH_HTB=y
CONFIG_NET_SCH_PRIO=y
CONFIG_NET=y
CONFIG_NF_CONNTRACK=y
CONFIG_NLS_ASCII=y
CONFIG_NLS_CODEPAGE_437=y
CONFIG_NLS_ISO8859_1=y
CONFIG_NO_HZ=y
CONFIG_NR_CPUS=8
CONFIG_OF_SLIMBUS=y
CONFIG_ONESHOT_SYNC=y
CONFIG_PACKET=y
CONFIG_PANIC_ON_DATA_CORRUPTION=y
CONFIG_PANIC_TIMEOUT=5
CONFIG_PARTITION_ADVANCED=y
CONFIG_PM_AUTOSLEEP=y
CONFIG_PM_RUNTIME=y
CONFIG_PM_WAKELOCKS_LIMIT=0
CONFIG_PM_WAKELOCKS=y
CONFIG_POWER_RESET_MSM=y
CONFIG_POWER_RESET=y
CONFIG_POWER_SUPPLY=y
CONFIG_PPP_ASYNC=y
CONFIG_PPP_BSDCOMP=y
CONFIG_PPP_DEFLATE=y
CONFIG_PPP_MPPE=y
CONFIG_PPP_MULTILINK=y
CONFIG_PPPOE=y
CONFIG_PPPOLAC=y
CONFIG_PPPOPNS=y
CONFIG_PPP_SYNC_TTY=y
CONFIG_PPP=y
CONFIG_PREEMPT=y
CONFIG_PRINTK_TIME=y
CONFIG_PROC_DEVICETREE=y
CONFIG_PROFILING=y
CONFIG_PSTORE_CONSOLE=y
CONFIG_PSTORE_RAM_ANNOTATION_APPEND=y
CONFIG_PSTORE_RAM=y
CONFIG_PSTORE=y
CONFIG_PWM_QPNP=y
CONFIG_PWM=y
CONFIG_QCOM_EARLY_RANDOM=y
CONFIG_QCOM_SPS_DMA=y
CONFIG_QPNP_CABLE_DETECTION=y
CONFIG_QPNP_LINEAR_CHARGER=y
CONFIG_QPNP_POWER_ON=y
CONFIG_QPNP_REVID=y
CONFIG_QPNP_VIBRATOR=y
CONFIG_QPNP_VM_BMS=y
CONFIG_QSEECOM=y
CONFIG_RCU_FAST_NO_HZ=y
CONFIG_RD_BZIP2=y
CONFIG_RD_LZMA=y
CONFIG_REGMAP_IRQ=y
CONFIG_REGMAP_SPI=y
CONFIG_REGMAP=y
CONFIG_REGULATOR_ARIZONA=y
CONFIG_REGULATOR_CPR=y
CONFIG_REGULATOR_FAN53555=y
CONFIG_REGULATOR_FIXED_VOLTAGE=y
CONFIG_REGULATOR_MEM_ACC=y
CONFIG_REGULATOR_ONSEMI_NCP6335D=y
CONFIG_REGULATOR_PROXY_CONSUMER=y
CONFIG_REGULATOR_QPNP=y
CONFIG_REGULATOR_RPM_SMD=y
CONFIG_REGULATOR_SPM=y
CONFIG_REGULATOR_STUB=y
CONFIG_REGULATOR_TPS65132=y
CONFIG_REGULATOR=y
CONFIG_RELAY=y
CONFIG_REMOTE_SPINLOCK_MSM=y
CONFIG_RESOURCE_COUNTERS=y
CONFIG_RMNET_DATA_DEBUG_PKT=y
CONFIG_RMNET_DATA_FC=y
CONFIG_RMNET_DATA=y
CONFIG_RTC_CLASS=y
CONFIG_RTC_DRV_QPNP=y
CONFIG_RT_GROUP_SCHED=y
CONFIG_SCHED_HMP=y
CONFIG_SCHED_MC=y
CONFIG_SCHEDSTATS=y
CONFIG_SCSI_MULTI_LUN=y
CONFIG_SCSI_SCAN_ASYNC=y
CONFIG_SCSI=y
CONFIG_SECCOMP_FILTER=y
CONFIG_SECCOMP=y
CONFIG_SEC_DRIVER=y
CONFIG_SECURE_TOUCH=y
CONFIG_SECURITY_NETWORK=y
CONFIG_SECURITY_SELINUX=y
CONFIG_SECURITY=y
CONFIG_SENSORS_ADSP=y
CONFIG_SENSORS_AK09912=y
CONFIG_SENSORS_LIS3DH=y
CONFIG_SENSORS_LM75=y
CONFIG_SENSORS_MPU6050=y
CONFIG_SENSORS_QPNP_ADC_CURRENT=y
CONFIG_SENSORS_QPNP_ADC_VOLTAGE=y
CONFIG_SENSORS_QPNP_CURRENT_MONITOR=y
CONFIG_SENSORS_STML0XX=y
CONFIG_SENSORS=y
CONFIG_SERIAL_MSM_HSL_CONSOLE=y
CONFIG_SERIAL_MSM_HSL=y
CONFIG_SERIAL_MSM_SMD=y
CONFIG_SLIMBUS_MSM_NGD=y
CONFIG_SLIMBUS=y
CONFIG_SMB135X_CHARGER=y
CONFIG_SMB1360_CHARGER_FG=y
CONFIG_SMB358_CHARGER=y
CONFIG_SMP=y
CONFIG_SND_SOC_ARIZONA=y
CONFIG_SND_SOC_FLORIDA=y
CONFIG_SND_SOC_FSA8500=y
CONFIG_SND_SOC_MSM8X16=y
CONFIG_SND_SOC_WM_ADSP=y
CONFIG_SND_SOC_WM_HUBS=y
CONFIG_SND_SOC=y
CONFIG_SND=y
CONFIG_SOCKEV_NLMCAST=y
CONFIG_SOFTLOCKUP_WATCHDOG_TEST=y
CONFIG_SOUND=y
CONFIG_SPI_MASTER=y
CONFIG_SPI_QUP=y
CONFIG_SPI_SPIDEV=y
CONFIG_SPI=y
CONFIG_SPMI_MSM_PMIC_ARB=y
CONFIG_SPMI=y
CONFIG_SPS_SUPPORT_NDP_BAM=y
CONFIG_SPS=y
CONFIG_STAGING=y
CONFIG_STRICT_MEMORY_RWX=y
CONFIG_SUSPEND_TIME_TIMEKEEPING=y
CONFIG_SUSPEND_TIME=y
CONFIG_SWAP=y
CONFIG_SWITCH=y
CONFIG_SYSVIPC=y
CONFIG_THERMAL_MONITOR=y
CONFIG_THERMAL_QPNP_ADC_TM=y
CONFIG_THERMAL_QPNP=y
CONFIG_THERMAL_TSENS8974=y
CONFIG_THERMAL=y
CONFIG_TIMER_STATS=y
CONFIG_TMPFS=y
CONFIG_TOUCHSCREEN_SYNAPTICS_DSX_FW_UPDATE_MMI=y
CONFIG_TOUCHSCREEN_SYNAPTICS_DSX_I2C=y
CONFIG_TOUCHSCREEN_SYNAPTICS_DSX_RMI_DEV=y
CONFIG_TOUCHSCREEN_TOUCHX_BASE=y
CONFIG_TOUCHSCREEN_TOUCHX=y
CONFIG_TUN=y
CONFIG_UHID=y
CONFIG_UID_STAT=y
CONFIG_UIO_MSM_SHAREDMEM=y
CONFIG_UIO=y
CONFIG_UNIX=y
CONFIG_USB_ACM=y
CONFIG_USB_ANNOUNCE_NEW_DEVICES=y
CONFIG_USB_BAM=y
CONFIG_USB_CCID_BRIDGE=y
CONFIG_USB_CI13XXX_MSM=y
CONFIG_USB_EHCI_EHSET=y
CONFIG_USB_EHCI_HCD=y
CONFIG_USB_EHCI_MSM_UICC=y
CONFIG_USB_EHCI_MSM=y
CONFIG_USB_GADGET=y
CONFIG_USB_G_ANDROID=y
CONFIG_USB_MON=y
CONFIG_USB_PHY=y
CONFIG_USB_SERIAL_CSVT=y
CONFIG_USB_SERIAL=y
CONFIG_USB_STORAGE_ALAUDA=y
CONFIG_USB_STORAGE_CYPRESS_ATACB=y
CONFIG_USB_STORAGE_DATAFAB=y
CONFIG_USB_STORAGE_FREECOM=y
CONFIG_USB_STORAGE_ISD200=y
CONFIG_USB_STORAGE_JUMPSHOT=y
CONFIG_USB_STORAGE_KARMA=y
CONFIG_USB_STORAGE_ONETOUCH=y
CONFIG_USB_STORAGE_SDDR09=y
CONFIG_USB_STORAGE_SDDR55=y
CONFIG_USB_STORAGE_USBAT=y
CONFIG_USB_STORAGE=y
CONFIG_USB=y
CONFIG_V4L_PLATFORM_DRIVERS=y
CONFIG_VFAT_FS=y
CONFIG_VFP=y
CONFIG_VIDEOBUF2_MSM_MEM=y
CONFIG_XFRM_MIGRATE=y
CONFIG_XFRM_STATISTICS=y
CONFIG_XFRM_SUB_POLICY=y
CONFIG_XFRM_USER=y
CONFIG_XFRM=y
CONFIG_ZRAM_LZ4_COMPRESS=y
CONFIG_ZRAM=y
CONFIG_ZSMALLOC=y
# Disabling for userdebug, for parity with lux 64 bit
```

## arch/arm/hotplug/Kconfig
```kconfig
config INTELLI_PLUG
        bool "Enable intelli-plug cpu hotplug driver"
        default n
        help
          Generic Intelli-plug cpu hotplug driver for ARM SOCs

config CLUSTER_PLUG
        bool "Enable cluster-plug cpu hotplug driver"
        depends on !INTELLI_PLUG
        default n
        help
          CPU hotplug driver designed for ARM big.LITTLE systems where
          both the big and little CPUs are of the same type. On these
          systems, it preferable to normall use the big cluster, and
          only activate the little cluster for highly parallel loads.
          This hotplug implementation always keeps the big cluster
          online, and only activates the little cluster for heavy
          parallel loads.
```

## drivers/misc/stml0xx/Kconfig
```kconfig
config SENSORHUB_DEBUG_LOGGING
	bool "sensorhub debug logging"
	default n
	help
	  Say yes here if you wish to enable debug
	  logging from the sensorhub.

config SENSORS_STML0XX
	tristate "STML0XX Sensor Processor"
	default n
	depends on SPI
	help
	  Say yes here if you wish to include the STM
	  STML0XX Sensor processor driver.

config MMI_HALL_NOTIFICATIONS
	bool "Enable hall effect sensor notifier"
	default n
	depends on SENSORS_STML0XX
	help
	  Support for hall effect sensor notifications.

config STML0XX_LED
	bool "STML0XX blinking LED notifications"
	default n
	depends on SENSORS_STML0XX
	help
	  Say yes here if you wish to have blinking notification
	  LED support for STML0XX controlled LEDs. This only
	  works on surnia and lux for the msm8916 family.
```
