## arch/arm/configs/msm8939-lux_defconfig
```kconfig
CONFIG_AEABI=y
CONFIG_ALSA_TO_H2W=y
CONFIG_ANDROID_BINDER_IPC=y
CONFIG_ANDROID_INTF_ALARM_DEV=y
CONFIG_ANDROID_LMK_ADJ_RBTREE=y
CONFIG_ANDROID_LOW_MEMORY_KILLER=y
CONFIG_ANDROID_TIMED_GPIO=y
CONFIG_ANDROID=y
CONFIG_APDS9930=y
CONFIG_ARCH_MSM8916=y
CONFIG_ARCH_MSM=y
CONFIG_ARM_DECOMPRESSOR_LIMIT=0x3200000
CONFIG_ASHMEM=y
CONFIG_AUDIT=y
CONFIG_AUTO_ZRELADDR=y
CONFIG_BACKLIGHT_CLASS_DEVICE=y
CONFIG_BACKLIGHT_LCD_SUPPORT=y
CONFIG_BACKLIGHT_LM3697=y
CONFIG_BACKLIGHT_LP855X=y
CONFIG_BALANCE_ANON_FILE_RECLAIM=y
CONFIG_BATTERY_BCL=y
CONFIG_BATTERY_MAX17042=y
CONFIG_BCM2079X=y
CONFIG_BLK_DEV_DM=y
CONFIG_BLK_DEV_INITRD=y
CONFIG_BLK_DEV_LOOP=y
CONFIG_BLK_DEV_RAM=y
CONFIG_BLK_DEV_SD=y
CONFIG_BOOTINFO=y
CONFIG_BOOTPARAM_SOFTLOCKUP_PANIC=y
CONFIG_BRIDGE_EBT_BROUTE=y
CONFIG_BRIDGE_NF_EBTABLES=y
CONFIG_BRIDGE=y
CONFIG_BT_BNEP_MC_FILTER=y
CONFIG_BT_BNEP_PROTO_FILTER=y
CONFIG_BT_BNEP=y
CONFIG_BT_HIDP=y
CONFIG_BT_RFCOMM_TTY=y
CONFIG_BT_RFCOMM=y
CONFIG_BT=y
CONFIG_BUS_TOPOLOGY_ADHOC=y
CONFIG_CC_OPTIMIZE_FOR_SIZE=n
CONFIG_CC_STACKPROTECTOR_REGULAR=y
CONFIG_CFG80211_INTERNAL_REGDB=y
CONFIG_CFG80211=y
CONFIG_CGROUP_CPUACCT=y
CONFIG_CGROUP_DEBUG=y
CONFIG_CGROUP_FREEZER=y
CONFIG_CGROUP_MEM_RES_CTLR_SWAP=y
CONFIG_CGROUP_MEM_RES_CTLR=y
CONFIG_CGROUP_SCHED=y
CONFIG_CGROUPS=y
CONFIG_CLS_U32_MARK=y
CONFIG_CLUSTER_PLUG=y
CONFIG_CMA_SIZE_MBYTES=8
CONFIG_CMA=y
CONFIG_CORESIGHT=n
CONFIG_CP_ACCESS=y
CONFIG_CPU_BOOST=y
CONFIG_CPU_FREQ_GOV_CONSERVATIVE=y
CONFIG_CPU_FREQ_GOV_INTERACTIVE=y
CONFIG_CPU_FREQ_GOV_LIONFISH=y
CONFIG_CPU_FREQ_GOV_ONDEMAND=y
CONFIG_CPU_FREQ_GOV_POWERSAVE=y
CONFIG_CPU_FREQ_GOV_USERSPACE=y
CONFIG_CPU_HAS_L2_PMU=y
CONFIG_CPU_IDLE_MULTIPLE_DRIVERS=y
CONFIG_CPU_IDLE=y
CONFIG_CRYPTO_AES_ARM_BS=y
CONFIG_CRYPTO_AES_ARM=y
CONFIG_CRYPTO_AES=y
CONFIG_CRYPTO_ANSI_CPRNG=y
CONFIG_CRYPTO_ARC4=y
CONFIG_CRYPTO_CTR=y
CONFIG_CRYPTO_DEV_QCEDEV=y
CONFIG_CRYPTO_DEV_QCE=y
CONFIG_CRYPTO_DEV_QCRYPTO=y
CONFIG_CRYPTO_MD4=y
CONFIG_CRYPTO_NULL=y
CONFIG_CRYPTO_RNG=y
CONFIG_CRYPTO_SHA1_ARM_NEON=y
CONFIG_CRYPTO_SHA1_ARM=y
CONFIG_CRYPTO_SHA256_ARM=y
CONFIG_CRYPTO_SHA256=y
CONFIG_CRYPTO_TWOFISH=y
CONFIG_CRYPTO_XCBC=y
CONFIG_CRYPTO_XTS=y
CONFIG_CRYPTO=y
CONFIG_DEBUG_INFO=y
CONFIG_DEBUG_MEMORY_INIT=y
CONFIG_DEBUG_MUTEXES=y
CONFIG_DIAG_CHAR=y
CONFIG_DIAG_EXTENSION_SLATE=y
CONFIG_DIAG_OVER_TTY=y
CONFIG_DMADEVICES=y
CONFIG_DM_CRYPT=y
CONFIG_DM_REQ_CRYPT=y
CONFIG_DM_VERITY=n
CONFIG_DUMMY=y
CONFIG_DYNAMIC_DEBUG=y
CONFIG_EARLY_PRINTK=y
CONFIG_EMBEDDED=y
CONFIG_ENABLE_LINUX_REG=y
CONFIG_ESD_FS=y
CONFIG_EXFAT_FS=y
CONFIG_EXT4_FS_SECURITY=y
CONFIG_EXT4_FS_XATTR=y
CONFIG_EXT4_FS=y
CONFIG_EXT4_USE_FOR_EXT23=y
CONFIG_F2FS_FS_SECURITY=y
CONFIG_F2FS_FS_XATTR=y
CONFIG_F2FS_FS=y
CONFIG_FAIL_PAGE_ALLOC=y
CONFIG_FAN5404X_CHARGER=y
CONFIG_FB_MSM_MDSS_KCAL_CTRL=y
CONFIG_FB_MSM_MDSS_TIMEOUT_DUMP=y
CONFIG_FB_MSM_MDSS_WRITEBACK=y
CONFIG_FB_MSM_MDSS=y
CONFIG_FB_MSM=y
CONFIG_FB_VIRTUAL=y
CONFIG_FB=y
CONFIG_FORCE_INSTRUCTION_ALIGNMENT=y
CONFIG_FUSE_FS=y
CONFIG_GPIO_ARIZONA=y
CONFIG_GPIO_QPNP_PIN=y
CONFIG_GPIO_SYSFS=y
CONFIG_HAPTIC_DRV2605=y
CONFIG_HAS_DMA=y
CONFIG_HAVE_ARCH_SECCOMP_FILTER=y
CONFIG_HID_APPLE=y
CONFIG_HID_ELECOM=y
CONFIG_HID_MAGICMOUSE=y
CONFIG_HID_MICROSOFT=y
CONFIG_HID_MULTITOUCH=y
CONFIG_HIGHMEM=y
CONFIG_HIGH_RES_TIMERS=y
CONFIG_HOB_SHARED_RAM=y
CONFIG_HW_RANDOM_MSM=y
CONFIG_HW_RANDOM=y
CONFIG_I2C_CHARDEV=y
CONFIG_I2C_MSM_V2=y
CONFIG_I2C=y
CONFIG_IKCONFIG_PROC=y
CONFIG_IKCONFIG=y
CONFIG_INET6_AH=y
CONFIG_INET6_ESP=y
CONFIG_INET6_IPCOMP=y
CONFIG_INET_AH=y
CONFIG_INET_ESP=y
CONFIG_INET_IPCOMP=y
CONFIG_INET_LRO=y
CONFIG_INET_XFRM_MODE_BEET=y
CONFIG_INET_XFRM_MODE_TRANSPORT=y
CONFIG_INET_XFRM_MODE_TUNNEL=y
CONFIG_INET_XFRM_TUNNEL=y
CONFIG_INET=y
CONFIG_INPUT_EVDEV=y
CONFIG_INPUT_GPIO=y
CONFIG_INPUT_HBTP_INPUT=y
CONFIG_INPUT_JOYSTICK=y
CONFIG_INPUT_KEYCHORD=y
CONFIG_INPUT_MISC=y
CONFIG_INPUT_MT_WRAPPER=y
CONFIG_INPUT_TOUCHSCREEN=y
CONFIG_INPUT_UINPUT=y
CONFIG_ION_MSM=y
CONFIG_ION=y
CONFIG_IOSCHED_BFQ=y
CONFIG_IOSCHED_FIOPS=y
CONFIG_IP6_NF_FILTER=y
CONFIG_IP6_NF_IPTABLES=y
CONFIG_IP6_NF_MANGLE=y
CONFIG_IP6_NF_RAW=y
CONFIG_IP6_NF_TARGET_REJECT=y
CONFIG_IP_ADVANCED_ROUTER=y
CONFIG_IPC_LOGGING=y
CONFIG_IPC_ROUTER_SECURITY=y
CONFIG_IPC_ROUTER=y
CONFIG_IP_MULTIPLE_TABLES=y
CONFIG_IP_NF_ARPFILTER=y
CONFIG_IP_NF_ARP_MANGLE=y
CONFIG_IP_NF_ARPTABLES=y
CONFIG_IP_NF_FILTER=y
CONFIG_IP_NF_IPTABLES=y
CONFIG_IP_NF_MANGLE=y
CONFIG_IP_NF_MATCH_AH=y
CONFIG_IP_NF_MATCH_ECN=y
CONFIG_IP_NF_MATCH_TTL=y
CONFIG_IP_NF_RAW=y
CONFIG_IP_NF_SECURITY=y
CONFIG_IP_NF_TARGET_MASQUERADE=y
CONFIG_IP_NF_TARGET_NETMAP=y
CONFIG_IP_NF_TARGET_REDIRECT=y
CONFIG_IP_NF_TARGET_REJECT=y
CONFIG_IP_PNP_DHCP=y
CONFIG_IP_PNP=y
CONFIG_IP_ROUTE_VERBOSE=y
CONFIG_IPV6_MIP6=y
CONFIG_IPV6_MULTIPLE_TABLES=y
CONFIG_IPV6_OPTIMISTIC_DAD=y
CONFIG_IPV6_PRIVACY=y
CONFIG_IPV6_ROUTE_INFO=y
CONFIG_IPV6_ROUTER_PREF=y
CONFIG_IPV6_SUBTREES=y
CONFIG_IPV6=y
CONFIG_ISDBT_NMI=y
CONFIG_KERNEL_MODE_NEON=y
CONFIG_KERNEL_XZ=y
CONFIG_KEYBOARD_GPIO=y
CONFIG_KEYS=y
CONFIG_KGSL_PER_PROCESS_PAGE_TABLE=y
CONFIG_KPROBES=y
CONFIG_L2TP_DEBUGFS=y
CONFIG_L2TP_ETH=y
CONFIG_L2TP_IP=y
CONFIG_L2TP_V3=y
CONFIG_L2TP=y
CONFIG_LCD_CLASS_DEVICE=y
CONFIG_LEDS_ATC=y
CONFIG_LEDS_BD65B60=y
CONFIG_LEDS_GPIO=y
CONFIG_LEDS_ISL98611=y
CONFIG_LEDS_MSM_GPIO_FLASH=y
CONFIG_LEDS_QPNP=y
CONFIG_LEDS_TRIGGERS=y
CONFIG_LOCKUP_DETECTOR=y
CONFIG_LSM_MMAP_MIN_ADDR=4096
CONFIG_LZ4_COMPRESS=y
CONFIG_LZ4_DECOMPRESS=y
CONFIG_MAGIC_SYSRQ=y
CONFIG_MD=y
CONFIG_MEDIA_CAMERA_SUPPORT=y
CONFIG_MEDIA_CONTROLLER=y
CONFIG_MEDIA_RADIO_SUPPORT=y
CONFIG_MEDIA_SUPPORT=y
CONFIG_MEM_SHARE_QMI_SERVICE=y
CONFIG_MFD_ARIZONA_SPI=y
CONFIG_MFD_ARIZONA=y
CONFIG_MFD_CORE=y
CONFIG_MFD_FLORIDA=y
CONFIG_MFD_TI_LMU=y
CONFIG_MMC_BLOCK_MINORS=32
CONFIG_MMC_CLKGATE=y
CONFIG_MMC_EMBEDDED_SDIO=y
CONFIG_MMC_MSM_RAW=y
CONFIG_MMC_PARANOID_SD_INIT=y
CONFIG_MMC_PERF_PROFILING=y
CONFIG_MMC_SDHCI_MSM=y
CONFIG_MMC_SDHCI_PLTFM=y
CONFIG_MMC_SDHCI=y
CONFIG_MMC_UNSAFE_RESUME=y
CONFIG_MMC=y
CONFIG_MMI_DEVICE_DTBS=y
CONFIG_MMI_FACTORY=y
CONFIG_MMI_LUX_DTB=y
CONFIG_MMI_RAM_INFO=y
CONFIG_MMI_SOC_INFO=y
CONFIG_MMI_UNIT_INFO=y
CONFIG_MMU500_ACTIVE_PREFETCH_BUG_WITH_SECTION_MAPPING=y
CONFIG_MODULE_EXTRA_COPY=y
CONFIG_MODULE_FORCE_UNLOAD=y
CONFIG_MODULE_SIG_FORCE=y
CONFIG_MODULE_SIG_SHA512=y
CONFIG_MODULE_SIG=y
CONFIG_MODULES=y
CONFIG_MODULE_UNLOAD=y
CONFIG_MODVERSIONS=y
CONFIG_MOT_UTAG=y
CONFIG_MSM_ADSP_LOADER=y
CONFIG_MSM_AVTIMER=y
CONFIG_MSM_BAM_DMUX=y
CONFIG_MSMB_CAMERA=y
CONFIG_MSMB_JPEG=y
CONFIG_MSM_BOOT_STATS=y
CONFIG_MSM_BUS_SCALING=y
CONFIG_MSM_CAMERA_SENSOR=y
CONFIG_MSM_CCI=y
CONFIG_MSM_COMMON_LOG=y
CONFIG_MSM_CORE_CTL_HELPER=y
CONFIG_MSM_CPP=y
CONFIG_MSM_CSI30_HEADER=y
CONFIG_MSM_CSID=y
CONFIG_MSM_CSIPHY=y
CONFIG_MSM_DIRECT_SCLK_ACCESS=y
CONFIG_MSM_DLOAD_MODE=y
CONFIG_MSM_ENABLE_WDOG_DEBUG_CONTROL=y
CONFIG_MSM_FORCE_WDOG_BITE_ON_PANIC=y
CONFIG_MSM_IOMMU_V1=y
CONFIG_MSM_IPC_ROUTER_SMD_XPRT=y
CONFIG_MSM_ISPIF=y
CONFIG_MSM_KGSL=y
CONFIG_MSM_L2_SPM=y
CONFIG_MSM_MDSS_PLL=y
CONFIG_MSM_MEMORY_DUMP_V2=y
CONFIG_MSM_PERFORMANCE=y
CONFIG_MSM_PIL_MSS_QDSP6V5=y
CONFIG_MSM_PIL_SSR_GENERIC=y
CONFIG_MSM_PIL=y
CONFIG_MSM_QMI_INTERFACE=y
CONFIG_MSM_QPNP_INT=y
CONFIG_MSM_RMNET_BAM=y
CONFIG_MSM_RTB_SEPARATE_CPUS=y
CONFIG_MSM_RTB=y
CONFIG_MSM_SCM=y
CONFIG_MSM_SMCMOD=y
CONFIG_MSM_SMD_PKT=y
CONFIG_MSM_SMD=y
CONFIG_MSM_SMEM_LOGGING=y
CONFIG_MSM_SMEM=y
CONFIG_MSM_SMP2P_TEST=y
CONFIG_MSM_SMP2P=y
CONFIG_MSM_SPM=y
CONFIG_MSM_SUBSYSTEM_RESTART=y
CONFIG_MSM_SYSMON_COMM=y
CONFIG_MSM_TZ_LOG_WDOG_DUMP=y
CONFIG_MSM_TZ_LOG=y
CONFIG_MSM_VIDC_V4L2=y
CONFIG_MSM_WATCHDOG_CTX_PRINT=y
CONFIG_MSM_WATCHDOG_V2=y
CONFIG_MSM_XPU_ERR_FATAL=y
CONFIG_MT9M114=y
CONFIG_MT9V113=y
CONFIG_NAMESPACES=y
CONFIG_NEON=y
CONFIG_NET_CLS_ACT=y
CONFIG_NET_CLS_FLOW=y
CONFIG_NET_CLS_FW=y
CONFIG_NET_CLS_U32=y
CONFIG_NETDEVICES=y
CONFIG_NET_EMATCH_CMP=y
CONFIG_NET_EMATCH_META=y
CONFIG_NET_EMATCH_NBYTE=y
CONFIG_NET_EMATCH_TEXT=y
CONFIG_NET_EMATCH_U32=y
CONFIG_NET_EMATCH=y
CONFIG_NETFILTER_TPROXY=y
CONFIG_NETFILTER_XT_MATCH_COMMENT=y
CONFIG_NETFILTER_XT_MATCH_CONNLIMIT=y
CONFIG_NETFILTER_XT_MATCH_CONNMARK=y
CONFIG_NETFILTER_XT_MATCH_CONNTRACK=y
CONFIG_NETFILTER_XT_MATCH_DSCP=y
CONFIG_NETFILTER_XT_MATCH_ESP=y
CONFIG_NETFILTER_XT_MATCH_HASHLIMIT=y
CONFIG_NETFILTER_XT_MATCH_HELPER=y
CONFIG_NETFILTER_XT_MATCH_IPRANGE=y
CONFIG_NETFILTER_XT_MATCH_LENGTH=y
CONFIG_NETFILTER_XT_MATCH_LIMIT=y
CONFIG_NETFILTER_XT_MATCH_MAC=y
CONFIG_NETFILTER_XT_MATCH_MARK=y
CONFIG_NETFILTER_XT_MATCH_MULTIPORT=y
CONFIG_NETFILTER_XT_MATCH_PKTTYPE=y
CONFIG_NETFILTER_XT_MATCH_POLICY=y
CONFIG_NETFILTER_XT_MATCH_QTAGUID=y
CONFIG_NETFILTER_XT_MATCH_QUOTA2_LOG=y
CONFIG_NETFILTER_XT_MATCH_QUOTA2=y
CONFIG_NETFILTER_XT_MATCH_QUOTA=y
CONFIG_NETFILTER_XT_MATCH_SOCKET=y
CONFIG_NETFILTER_XT_MATCH_STATE=y
CONFIG_NETFILTER_XT_MATCH_STATISTIC=y
CONFIG_NETFILTER_XT_MATCH_STRING=y
CONFIG_NETFILTER_XT_MATCH_TCPMSS=y
CONFIG_NETFILTER_XT_MATCH_TIME=y
CONFIG_NETFILTER_XT_MATCH_U32=y
CONFIG_NETFILTER_XT_TARGET_CLASSIFY=y
CONFIG_NETFILTER_XT_TARGET_CONNMARK=y
CONFIG_NETFILTER_XT_TARGET_CONNSECMARK=y
CONFIG_NETFILTER_XT_TARGET_HARDIDLETIMER=y
CONFIG_NETFILTER_XT_TARGET_IDLETIMER=y
CONFIG_NETFILTER_XT_TARGET_LOG=y
CONFIG_NETFILTER_XT_TARGET_MARK=y
CONFIG_NETFILTER_XT_TARGET_NFLOG=y
CONFIG_NETFILTER_XT_TARGET_NFQUEUE=y
CONFIG_NETFILTER_XT_TARGET_NOTRACK=y
CONFIG_NETFILTER_XT_TARGET_SECMARK=y
CONFIG_NETFILTER_XT_TARGET_TCPMSS=y
CONFIG_NETFILTER_XT_TARGET_TPROXY=y
CONFIG_NETFILTER_XT_TARGET_TRACE=y
CONFIG_NETFILTER=y
CONFIG_NET_KEY_MIGRATE=y
CONFIG_NET_KEY=y
CONFIG_NET_SCHED=y
CONFIG_NET_SCH_HTB=y
CONFIG_NET_SCH_PRIO=y
CONFIG_NET=y
CONFIG_NF_CONNTRACK_AMANDA=y
CONFIG_NF_CONNTRACK_EVENTS=y
CONFIG_NF_CONNTRACK_FTP=y
CONFIG_NF_CONNTRACK_H323=y
CONFIG_NF_CONNTRACK_IPV4=y
CONFIG_NF_CONNTRACK_IPV6=y
CONFIG_NF_CONNTRACK_IRC=y
CONFIG_NF_CONNTRACK_NETBIOS_NS=y
CONFIG_NF_CONNTRACK_PPTP=y
CONFIG_NF_CONNTRACK_SANE=y
CONFIG_NF_CONNTRACK_SECMARK=y
CONFIG_NF_CONNTRACK_SIP=y
CONFIG_NF_CONNTRACK_TFTP=y
CONFIG_NF_CONNTRACK=y
CONFIG_NF_CT_NETLINK=y
CONFIG_NF_CT_PROTO_DCCP=y
CONFIG_NF_CT_PROTO_SCTP=y
CONFIG_NF_CT_PROTO_UDPLITE=y
CONFIG_NF_NAT_IPV4=y
CONFIG_NL80211_TESTMODE=y
CONFIG_NLS_ASCII=y
CONFIG_NLS_CODEPAGE_437=y
CONFIG_NLS_ISO8859_1=y
CONFIG_NO_HZ=y
CONFIG_NR_CPUS=8
CONFIG_OF_SLIMBUS=y
CONFIG_ONESHOT_SYNC=y
CONFIG_OPROFILE=y
CONFIG_OV5645=y
CONFIG_PACKET=y
CONFIG_PANIC_ON_DATA_CORRUPTION=y
CONFIG_PANIC_TIMEOUT=5
CONFIG_PARTITION_ADVANCED=y
CONFIG_PM_AUTOSLEEP=y
CONFIG_PM_RUNTIME=y
CONFIG_PM_WAKELOCKS_LIMIT=0
CONFIG_PM_WAKELOCKS=y
CONFIG_POWER_RESET_MSM=y
CONFIG_POWER_RESET=y
CONFIG_POWER_SUPPLY=y
CONFIG_POWERSUSPEND=y
CONFIG_PPP_ASYNC=y
CONFIG_PPP_BSDCOMP=y
CONFIG_PPP_DEFLATE=y
CONFIG_PPP_FILTER=y
CONFIG_PPP_MPPE=y
CONFIG_PPP_MULTILINK=y
CONFIG_PPPOE=y
CONFIG_PPPOL2TP=y
CONFIG_PPPOLAC=y
CONFIG_PPPOPNS=y
CONFIG_PPP_SYNC_TTY=y
CONFIG_PPP=y
CONFIG_PREEMPT=y
CONFIG_PRIMA_WLAN_11AC_HIGH_TP=y
CONFIG_PRIMA_WLAN_LFR=y
CONFIG_PRIMA_WLAN_OKC=y
CONFIG_PRINTK_TIME=y
CONFIG_PROC_DEVICETREE=y
CONFIG_PROCESS_RECLAIM=y
CONFIG_PROFILING=y
CONFIG_PRONTO_WLAN=m
CONFIG_PSTORE_CONSOLE=y
CONFIG_PSTORE_RAM_ANNOTATION_APPEND=y
CONFIG_PSTORE_RAM=y
CONFIG_PSTORE=y
CONFIG_PWM_QPNP=y
CONFIG_PWM=y
CONFIG_QCOM_EARLY_RANDOM=y
CONFIG_QCOM_SPS_DMA=y
CONFIG_QCOM_TDLS=y
CONFIG_QCOM_VOWIFI_11R=y
CONFIG_QPNP_CABLE_DETECTION=y
CONFIG_QPNP_LINEAR_CHARGER=y
CONFIG_QPNP_POWER_ON=y
CONFIG_QPNP_REVID=y
CONFIG_QPNP_VIBRATOR=y
CONFIG_QPNP_VM_BMS=y
CONFIG_QSEECOM=y
CONFIG_RADIO_IRIS_TRANSPORT=y
CONFIG_RADIO_IRIS=y
CONFIG_RCU_FAST_NO_HZ=y
CONFIG_RD_BZIP2=y
CONFIG_RD_LZMA=y
CONFIG_REGMAP_IRQ=y
CONFIG_REGMAP_SPI=y
CONFIG_REGMAP=y
CONFIG_REGULATOR_ARIZONA=y
CONFIG_REGULATOR_CPR=y
CONFIG_REGULATOR_FAN53555=y
CONFIG_REGULATOR_FIXED_VOLTAGE=y
CONFIG_REGULATOR_MEM_ACC=y
CONFIG_REGULATOR_ONSEMI_NCP6335D=y
CONFIG_REGULATOR_PROXY_CONSUMER=y
CONFIG_REGULATOR_QPNP=y
CONFIG_REGULATOR_RPM_SMD=y
CONFIG_REGULATOR_SPM=y
CONFIG_REGULATOR_STUB=y
CONFIG_REGULATOR_TPS65132=y
CONFIG_REGULATOR=y
CONFIG_RELAY=y
CONFIG_REMOTE_SPINLOCK_MSM=y
CONFIG_RESOURCE_COUNTERS=y
CONFIG_RMNET_DATA_DEBUG_PKT=y
CONFIG_RMNET_DATA_FC=y
CONFIG_RMNET_DATA=y
CONFIG_RTC_CLASS=y
CONFIG_RTC_DRV_QPNP=y
CONFIG_RT_GROUP_SCHED=y
CONFIG_SCHED_FREQ_INPUT=y
CONFIG_SCHED_HMP=y
CONFIG_SCHED_MC=y
CONFIG_SCHEDSTATS=y
CONFIG_SCSI_MULTI_LUN=y
CONFIG_SCSI_SCAN_ASYNC=y
CONFIG_SCSI=y
CONFIG_SECCOMP_FILTER=y
CONFIG_SECCOMP=y
CONFIG_SEC_DRIVER=y
CONFIG_SECURE_TOUCH=y
CONFIG_SECURITY_NETWORK=y
CONFIG_SECURITY_SELINUX=y
CONFIG_SECURITY=y
CONFIG_SENSORS_ADSP=y
CONFIG_SENSORS_AK09912=y
CONFIG_SENSORS_LIS3DH=y
CONFIG_SENSORS_LM75=y
CONFIG_SENSORS_MPU6050=y
CONFIG_SENSORS_QPNP_ADC_CURRENT=y
CONFIG_SENSORS_QPNP_ADC_VOLTAGE=y
CONFIG_SENSORS_QPNP_CURRENT_MONITOR=y
CONFIG_SENSORS_STML0XX=y
CONFIG_SENSORS=y
CONFIG_SERIAL_MSM_HSL_CONSOLE=y
CONFIG_SERIAL_MSM_HSL=y
CONFIG_SERIAL_MSM_SMD=y
CONFIG_SLIMBUS_MSM_NGD=y
CONFIG_SLIMBUS=y
CONFIG_SMB135X_CHARGER=y
CONFIG_SMB1360_CHARGER_FG=y
CONFIG_SMB358_CHARGER=y
CONFIG_SMP=y
CONFIG_SND_SOC_ARIZONA=y
CONFIG_SND_SOC_FLORIDA=y
CONFIG_SND_SOC_FSA8500=y
CONFIG_SND_SOC_MSM8X16=y
CONFIG_SND_SOC_WM_ADSP=y
CONFIG_SND_SOC_WM_HUBS=y
CONFIG_SND_SOC=y
CONFIG_SND_USB_AUDIO=y
CONFIG_SND=y
CONFIG_SOCKEV_NLMCAST=y
CONFIG_SOFTLOCKUP_WATCHDOG_TEST=y
CONFIG_SOUND=y
CONFIG_SPI_MASTER=y
CONFIG_SPI_QUP=y
CONFIG_SPI=y
CONFIG_SPMI_MSM_PMIC_ARB=y
CONFIG_SPMI=y
CONFIG_SPS_SUPPORT_NDP_BAM=y
CONFIG_SPS=y
CONFIG_STAGING=y
CONFIG_STRICT_MEMORY_RWX=y
CONFIG_SUSPEND_TIME_TIMEKEEPING=y
CONFIG_SUSPEND_TIME=y
CONFIG_SWAP=y
CONFIG_SWITCH=y
CONFIG_SYSVIPC=y
CONFIG_THERMAL_MONITOR=y
CONFIG_THERMAL_QPNP_ADC_TM=y
CONFIG_THERMAL_QPNP=y
CONFIG_THERMAL_TSENS8974=y
CONFIG_THERMAL=y
CONFIG_TIMER_STATS=y
CONFIG_TMPFS=y
CONFIG_TOUCHSCREEN_SYNAPTICS_DSX_FW_UPDATE_MMI=y
CONFIG_TOUCHSCREEN_SYNAPTICS_DSX_I2C=y
CONFIG_TOUCHSCREEN_SYNAPTICS_DSX_RMI_DEV=y
CONFIG_TOUCHSCREEN_TOUCHX_BASE=y
CONFIG_TOUCHSCREEN_TOUCHX=y
CONFIG_TUN=y
CONFIG_UHID=y
CONFIG_UID_CPUTIME=y
CONFIG_UID_STAT=y
CONFIG_UIO_MSM_SHAREDMEM=y
CONFIG_UIO=y
CONFIG_UNIX=y
CONFIG_USB_ACM=y
CONFIG_USB_ANNOUNCE_NEW_DEVICES=y
CONFIG_USB_BAM=y
CONFIG_USB_CCID_BRIDGE=y
CONFIG_USB_CI13XXX_MSM=y
CONFIG_USB_EHCI_EHSET=y
CONFIG_USB_EHCI_HCD=y
CONFIG_USB_EHCI_MSM_UICC=y
CONFIG_USB_EHCI_MSM=y
CONFIG_USB_GADGET=y
CONFIG_USB_G_ANDROID=y
CONFIG_USB_MON=y
CONFIG_USB_PHY=y
CONFIG_USB_SERIAL_CSVT=y
CONFIG_USB_SERIAL=y
CONFIG_USB_STORAGE_ALAUDA=y
CONFIG_USB_STORAGE_CYPRESS_ATACB=y
CONFIG_USB_STORAGE_DATAFAB=y
CONFIG_USB_STORAGE_FREECOM=y
CONFIG_USB_STORAGE_ISD200=y
CONFIG_USB_STORAGE_JUMPSHOT=y
CONFIG_USB_STORAGE_KARMA=y
CONFIG_USB_STORAGE_ONETOUCH=y
CONFIG_USB_STORAGE_SDDR09=y
CONFIG_USB_STORAGE_SDDR55=y
CONFIG_USB_STORAGE_USBAT=y
CONFIG_USB_STORAGE=y
CONFIG_USB=y
CONFIG_V4L_PLATFORM_DRIVERS=y
CONFIG_VFAT_FS=y
CONFIG_VFP=y
CONFIG_VIDEOBUF2_MSM_MEM=y
CONFIG_VIDEO_V4L2_SUBDEV_API=y
CONFIG_W1_MASTER_GPIO=y
CONFIG_W1_SLAVE_DS2502=y
CONFIG_W1=y
CONFIG_WCNSS_CORE_PRONTO=y
CONFIG_WCNSS_CORE=y
CONFIG_WCNSS_MEM_PRE_ALLOC=y
CONFIG_WCNSS_REGISTER_DUMP_ON_BITE=y
CONFIG_WLAN_FEATURE_11W=y
CONFIG_XFRM_MIGRATE=y
CONFIG_XFRM_STATISTICS=y
CONFIG_XFRM_SUB_POLICY=y
CONFIG_XFRM_USER=y
CONFIG_XFRM=y
CONFIG_ZRAM_LZ4_COMPRESS=y
CONFIG_ZRAM=y
CONFIG_ZSMALLOC=y
```
